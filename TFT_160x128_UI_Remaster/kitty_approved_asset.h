#pragma once
#include <Arduino.h>
#include <Adafruit_GFX.h>

// Exact RGB565 kitty asset from the user-approved mockup.
// Source: спящий_пиксельный_котёнок_и_zzz.png
// Source SHA256: d5bfbc22538a90c5c940af2dce1039b9004c95f641929d655953c0ab2091c00f
// Nearest-neighbour transform: 1402x1122 -> 160x128.
// Rows 0..52 contain only generated static Z/background and are omitted.
// Kitty pixels in rows 53..127 are preserved exactly after RGB565 conversion.
// Z animation remains separate.

namespace TftUiAssets {

constexpr int16_t KITTY_APPROVED_X = 0;
constexpr int16_t KITTY_APPROVED_Y = 53;
constexpr int16_t KITTY_APPROVED_W = 160;
constexpr int16_t KITTY_APPROVED_H = 75;
constexpr size_t KITTY_APPROVED_PIXELS = 12000;
constexpr size_t KITTY_PACKED_BYTES = 13500;

const uint16_t kittyApprovedPalette[295] PROGMEM = {
  0x0000, 0x0020, 0xC5F5, 0xEF1A, 0xEF3B, 0xBC0D, 0xC4AF, 0xDE36, 0xEF5B, 0x630B, 0x9C90, 0xEEFA, 0xA36B, 0xBBEC, 0xC44E, 0xC46E,
  0xFFDD, 0xE6F9, 0xE71A, 0x7B4C, 0xB3CC, 0xCC6E, 0xDCF0, 0xB532, 0x52AA, 0x528A, 0x5ACB, 0x5AAA, 0xF77B, 0x4A48, 0xDCD0, 0xDCCF,
  0xDD10, 0xDDB3, 0x0841, 0xD678, 0xDEB8, 0xDE98, 0x944F, 0xC616, 0x62EB, 0xABED, 0xB3AB, 0xD4D0, 0x0840, 0xEF3A, 0xB553, 0x0861,
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  0x0862, 0x630C, 0xE719, 0xD656, 0x2966, 0x732B, 0xC594,
};

const char kittyApprovedPackedB64[] PROGMEM =
#include "kitty_b64_0.inc"
#include "kitty_b64_1.inc"
#include "kitty_b64_2.inc"
#include "kitty_b64_3.inc"
;

inline int8_t kittyB64Value(char c) {
  if (c >= 'A' && c <= 'Z') return c - 'A';
  if (c >= 'a' && c <= 'z') return c - 'a' + 26;
  if (c >= '0' && c <= '9') return c - '0' + 52;
  if (c == '+') return 62;
  if (c == '/') return 63;
  return -1;
}

inline bool decodeApprovedKitty(uint16_t *pixels) {
  uint8_t *packed = static_cast<uint8_t *>(malloc(KITTY_PACKED_BYTES));
  if (!packed) return false;

  size_t outPos = 0;
  uint32_t acc = 0;
  uint8_t accBits = 0;

  for (size_t i = 0; outPos < KITTY_PACKED_BYTES; ++i) {
    const char c = static_cast<char>(pgm_read_byte(&kittyApprovedPackedB64[i]));
    if (c == '\0' || c == '=') break;
    const int8_t v = kittyB64Value(c);
    if (v < 0) continue;

    acc = (acc << 6) | static_cast<uint8_t>(v);
    accBits += 6;

    while (accBits >= 8 && outPos < KITTY_PACKED_BYTES) {
      accBits -= 8;
      packed[outPos++] = (acc >> accBits) & 0xFF;
      if (accBits == 0) acc = 0;
      else acc &= (1UL << accBits) - 1;
    }
  }

  if (outPos != KITTY_PACKED_BYTES) {
    free(packed);
    return false;
  }

  size_t bytePos = 0;
  uint32_t bitBuf = 0;
  uint8_t bitCount = 0;

  for (size_t p = 0; p < KITTY_APPROVED_PIXELS; ++p) {
    while (bitCount < 9) {
      bitBuf = (bitBuf << 8) | packed[bytePos++];
      bitCount += 8;
    }

    bitCount -= 9;
    const uint16_t paletteIndex = (bitBuf >> bitCount) & 0x01FF;
    if (bitCount == 0) bitBuf = 0;
    else bitBuf &= (1UL << bitCount) - 1;

    pixels[p] = pgm_read_word(&kittyApprovedPalette[paletteIndex]);
  }

  free(packed);
  return true;
}

inline void drawApprovedKitty(Adafruit_GFX &gfx) {
  static uint16_t pixels[KITTY_APPROVED_PIXELS];
  static bool decoded = false;
  static bool decodeFailed = false;

  if (!decoded && !decodeFailed) {
    decoded = decodeApprovedKitty(pixels);
    decodeFailed = !decoded;
  }

  if (decoded) {
    gfx.drawRGBBitmap(KITTY_APPROVED_X, KITTY_APPROVED_Y,
                      pixels, KITTY_APPROVED_W, KITTY_APPROVED_H);
  }
}

} // namespace TftUiAssets
